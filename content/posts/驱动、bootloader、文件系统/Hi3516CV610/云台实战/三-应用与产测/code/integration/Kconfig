## content/posts/驱动、bootloader、文件系统/Hi3516CV610/云台实战/三-应用与产测/code/integration/Kconfig
```kconfig
menu "PTZ Options"
config PTZ
    bool "PTZ control in Func"
    depends on MODE_HI3516CV610_00S
    default n
    help
        Build the asynchronous PTZ manager, factory control interfaces and
        package the tuling_ptzmotor module. Startup never moves the motors.
endmenu
```
